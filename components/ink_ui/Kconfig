## components/ink_ui/Kconfig
```kconfig
menu "InkUI Configuration"
    config INKUI_PROFILE
        bool "Enable InkUI performance profiling"
        default n
        help
            Enable profiling instrumentation in InkUI rendering pipeline.
            Outputs per-stage timing to serial log via ESP_LOGI.
            When disabled, all profiling macros compile to nothing.
endmenu
```

## sdkconfig.defaults
```kconfig
# Target: ESP32-S3
CONFIG_IDF_TARGET="esp32s3"

# Flash: 16MB, QIO
CONFIG_ESPTOOLPY_FLASHSIZE_16MB=y
CONFIG_ESPTOOLPY_FLASHMODE_QIO=y
CONFIG_ESPTOOLPY_FLASHFREQ_80M=y

# PSRAM: 8MB Octal
CONFIG_SPIRAM=y
CONFIG_SPIRAM_MODE_OCT=y
CONFIG_SPIRAM_SPEED_80M=y

# Data cache: 64B line size (epdiy LCD DMA 要求)
CONFIG_ESP32S3_DATA_CACHE_64KB=y
CONFIG_ESP32S3_DATA_CACHE_LINE_64B=y

# Partition table: custom
CONFIG_PARTITION_TABLE_CUSTOM=y
CONFIG_PARTITION_TABLE_CUSTOM_FILENAME="partitions.csv"

# Log level: Info
CONFIG_LOG_DEFAULT_LEVEL_INFO=y

# FreeRTOS tick rate
CONFIG_FREERTOS_HZ=1000

# USB CDC console
CONFIG_ESP_CONSOLE_USB_SERIAL_JTAG=y
```
